/* USER CODE BEGIN Header */
/**
 ******************************************************************************
 * @file           : main.c
 * @brief          : Main program body
 ******************************************************************************
 * @attention
 *
 * Copyright (c) 2025 STMicroelectronics.
 * All rights reserved.
 *
 * This software is licensed under terms that can be found in the LICENSE file
 * in the root directory of this software component.
 * If no LICENSE file comes with this software, it is provided AS-IS.
 *
 ******************************************************************************
 */
/* USER CODE END Header */
/* Includes ------------------------------------------------------------------*/
#include "main.h"

/* Private includes ----------------------------------------------------------*/
/* USER CODE BEGIN Includes */
#include "u8g2.h"
#include "DWT_Delay.h"
#include "Timer_Delay.h"
#include <stdbool.h>

/* USER CODE END Includes */

/* Private typedef -----------------------------------------------------------*/
/* USER CODE BEGIN PTD */

/* USER CODE END PTD */

/* Private define ------------------------------------------------------------*/
/* USER CODE BEGIN PD */

/* USER CODE END PD */

/* Private macro -------------------------------------------------------------*/
/* USER CODE BEGIN PM */

/* USER CODE END PM */

/* Private variables ---------------------------------------------------------*/
I2C_HandleTypeDef hi2c1;

TIM_HandleTypeDef htim1;
TIM_HandleTypeDef htim2;
TIM_HandleTypeDef htim3;

typedef enum
{
  MAIN,
  STATE1,
  STATE2,
  STATE3,
  prstinit1,
  prstinit2,
  prstinit3,
  prst_s1,
  prst_s2,
  prst_s3,
  RD_PRST_1,
  RD_PRST_2,
  RD_PRST_3,
  BANK_1,
  BANK_2,
  BANK_3,
  BANK_4,
  BANK_5,
  BANK_6,
  BANK_7,
  BANK_8,
  bypassed
} SystemState;
/* USER CODE BEGIN PV */
#define DEBOUNCE_DELAY 500 // 50 ms debounce delay
uint32_t last_interrupt_time = 0;
uint32_t lastStateChangeTime = 0; // Declare lastStateChangeTime
uint32_t lastBlinkTime = 0;
uint32_t currentTimepreset1;
uint8_t system_locked = 0;
bool displayOn = false;
bool RD_PRST_state = false;
int previesly_pressed = 0;
int preset_bank = 0;
int Preset_Bank_selected = 0;
uint8_t SW_3PDT_ON = 0;
uint16_t gain_press_count = 0;
uint16_t tone_press_count = 0;
uint16_t level_press_count = 0;
volatile uint16_t button1_press_count = 0;
volatile uint16_t button2_press_count = 0;
volatile uint16_t button3_press_count = 0;
u8g2_t u8g2; // u8g2 display instance
uint8_t lastState;
uint8_t u8x8_gpio_and_delay_stm32(U8X8_UNUSED u8x8_t *u8x8, U8X8_UNUSED uint8_t msg, U8X8_UNUSED uint8_t arg_int, U8X8_UNUSED void *arg_ptr);
uint8_t u8x8_byte_hw_i2c_stm32(u8x8_t *u8x8, uint8_t msg, uint8_t arg_int, void *arg_ptr);

#define EEPROM_ADDR 0xA0
uint8_t toWrite1[6];
uint8_t toWrite2[6];
uint8_t toWrite3[6];
uint8_t toRead1[6];
uint8_t toRead2[6];
uint8_t toRead3[6];
/* USER CODE END PV */

/* Private function prototypes -----------------------------------------------*/
void SystemClock_Config(void);
static void MX_GPIO_Init(void);
static void MX_TIM2_Init(void);
static void MX_TIM3_Init(void);
static void MX_TIM1_Init(void);
static void MX_I2C1_Init(void);
/* USER CODE BEGIN PFP */
SystemState currentState = MAIN;

int16_t last_encoder_position1 = 0;
int16_t last_encoder_position2 = 0;
int16_t last_encoder_position3 = 0;

int16_t encoder_position1 = 0;
int16_t encoder_position2 = 0;
int16_t encoder_position3 = 0;

int16_t prev_enc_pos1 = 0;
int16_t prev_enc_pos2 = 0;
int16_t prev_enc_pos3 = 0;

int16_t GP_steps;
int16_t TP_steps;
int16_t LP_steps;

uint16_t encoder1_binary = 0;
uint16_t encoder2_binary = 0;
uint16_t encoder3_binary = 0;

uint32_t lastActivityTime = 0;

uint8_t mapped_value1 = 2;
uint8_t mapped_value2 = 2;
uint8_t mapped_value3 = 2;

uint16_t GP_map_v = 0;
uint16_t TP_map_v = 0;
uint16_t LP_map_v = 0;

/* USER CODE END PFP */

/* Private user code ---------------------------------------------------------*/
/* USER CODE BEGIN 0 */

uint8_t u8x8_gpio_and_delay_stm32(U8X8_UNUSED u8x8_t *u8x8,
                                  U8X8_UNUSED uint8_t msg, U8X8_UNUSED uint8_t arg_int,
                                  U8X8_UNUSED void *arg_ptr)
{
  switch (msg)
  {
  case U8X8_MSG_DELAY_MILLI:
    HAL_Delay(arg_int);
    break;
  default:
    break;
  }
  return 1;
}
uint8_t u8x8_byte_hw_i2c_stm32(u8x8_t *u8x8, uint8_t msg, uint8_t arg_int, void *arg_ptr)
{
  static uint8_t buffer[32];
  static uint8_t buf_idx;
  uint8_t *data;

  switch (msg)
  {
  case U8X8_MSG_BYTE_SEND:
    data = (uint8_t *)arg_ptr;
    while (arg_int > 0)
    {
      buffer[buf_idx++] = *data;
      data++;
      arg_int--;
    }
    break;
  case U8X8_MSG_BYTE_INIT:
    break;
  case U8X8_MSG_BYTE_SET_DC:
    break;
  case U8X8_MSG_BYTE_START_TRANSFER:
    buf_idx = 0;
    break;
  case U8X8_MSG_BYTE_END_TRANSFER:
    HAL_I2C_Master_Transmit(&hi2c1, (0x3C << 1), buffer, buf_idx, HAL_MAX_DELAY);
    break;
  default:
    return 0;
  }
  return 1;
}
void UpdateState(SystemState *state, int16_t encoder_position1, int16_t encoder_position2, int16_t encoder_position3)
{
  uint32_t current_time = HAL_GetTick();

  // Only update state based on encoder positions if not in prstinit1 state
  if (*state != prstinit1 || *state != prstinit2 || *state != prstinit3 || RD_PRST_state == false)
  {
    if (encoder_position1 != last_encoder_position1)
    {
      *state = STATE1;
      lastActivityTime = current_time;
    }
    else if (encoder_position2 != last_encoder_position2)
    {
      *state = STATE2;
      lastActivityTime = current_time;
    }
    else if (encoder_position3 != last_encoder_position3)
    {
      *state = STATE3;
      lastActivityTime = current_time;
    }
  }

  last_encoder_position1 = encoder_position1;
  last_encoder_position2 = encoder_position2;
  last_encoder_position3 = encoder_position3;
}
u8g2_uint_t ClampValue(int16_t value, u8g2_uint_t min, u8g2_uint_t max)
{
  if (value < min)
    return min;
  if (value > max)
    return max;
  return (u8g2_uint_t)value;
}
uint8_t MapValue(int16_t value, int16_t in_min, int16_t in_max, uint8_t out_min, uint8_t out_max)
{
  return out_min + (uint8_t)((float)(value - in_min) * (float)(out_max - out_min) / (float)(in_max - in_min));
}
void handleprstinit1()
{
  currentTimepreset1 = HAL_GetTick();
  if (currentTimepreset1 - lastBlinkTime >= 600) // 250 ms delay
  {
    lastBlinkTime = currentTimepreset1;
    displayOn = !displayOn; // Toggle display state

    if (displayOn)
    {
      u8g2_ClearBuffer(&u8g2);
      u8g2_SetBitmapMode(&u8g2, 1);
      u8g2_SetFontMode(&u8g2, 1);
      u8g2_DrawBox(&u8g2, 0, 0, 64, 64);
      u8g2_SetDrawColor(&u8g2, 2);
      u8g2_SetFont(&u8g2, u8g2_font_profont29_tr);
      u8g2_DrawStr(&u8g2, 10, 55, "SET");
      u8g2_DrawStr(&u8g2, 10, 28, "PRE");
      u8g2_DrawStr(&u8g2, 90, 43, "1");
      u8g2_SetDrawColor(&u8g2, 1);
      u8g2_SetFont(&u8g2, u8g2_font_profont10_tr);
      u8g2_DrawStr(&u8g2, 78, 11, "SAVE TO");
      u8g2_SendBuffer(&u8g2);
    }
    else
    {
      u8g2_ClearBuffer(&u8g2);
      u8g2_SetBitmapMode(&u8g2, 1);
      u8g2_SetFontMode(&u8g2, 1);
      u8g2_DrawBox(&u8g2, 0, 0, 64, 64);
      u8g2_SetDrawColor(&u8g2, 2);
      u8g2_SetFont(&u8g2, u8g2_font_profont29_tr);
      u8g2_DrawStr(&u8g2, 10, 55, "SET");
      u8g2_DrawStr(&u8g2, 10, 28, "PRE");
      u8g2_SetDrawColor(&u8g2, 1);
      u8g2_DrawBox(&u8g2, 80, 19, 32, 29);
      u8g2_SetDrawColor(&u8g2, 2);
      u8g2_DrawStr(&u8g2, 90, 43, "1");
      u8g2_SetDrawColor(&u8g2, 1);
      u8g2_SetFont(&u8g2, u8g2_font_profont10_tr);
      u8g2_DrawStr(&u8g2, 78, 11, "SAVE TO");
      u8g2_SendBuffer(&u8g2);
    }
  }
}
void handleprstinit2()
{
  currentTimepreset1 = HAL_GetTick();
  if (currentTimepreset1 - lastBlinkTime >= 600) // 250 ms delay
  {
    lastBlinkTime = currentTimepreset1;
    displayOn = !displayOn; // Toggle display state

    if (displayOn)
    {
      u8g2_ClearBuffer(&u8g2);
      u8g2_SetBitmapMode(&u8g2, 1);
      u8g2_SetFontMode(&u8g2, 1);
      u8g2_DrawBox(&u8g2, 0, 0, 64, 64);
      u8g2_SetDrawColor(&u8g2, 2);
      u8g2_SetFont(&u8g2, u8g2_font_profont29_tr);
      u8g2_DrawStr(&u8g2, 10, 55, "SET");
      u8g2_DrawStr(&u8g2, 10, 28, "PRE");
      u8g2_DrawStr(&u8g2, 90, 43, "2");
      u8g2_SetDrawColor(&u8g2, 1);
      u8g2_SetFont(&u8g2, u8g2_font_profont10_tr);
      u8g2_DrawStr(&u8g2, 78, 11, "SAVE TO");
      u8g2_SendBuffer(&u8g2);
    }
    else
    {
      u8g2_ClearBuffer(&u8g2);
      u8g2_SetBitmapMode(&u8g2, 1);
      u8g2_SetFontMode(&u8g2, 1);
      u8g2_DrawBox(&u8g2, 0, 0, 64, 64);
      u8g2_SetDrawColor(&u8g2, 2);
      u8g2_SetFont(&u8g2, u8g2_font_profont29_tr);
      u8g2_DrawStr(&u8g2, 10, 55, "SET");
      u8g2_DrawStr(&u8g2, 10, 28, "PRE");
      u8g2_SetDrawColor(&u8g2, 1);
      u8g2_DrawBox(&u8g2, 80, 19, 32, 29);
      u8g2_SetDrawColor(&u8g2, 2);
      u8g2_DrawStr(&u8g2, 90, 43, "2");
      u8g2_SetDrawColor(&u8g2, 1);
      u8g2_SetFont(&u8g2, u8g2_font_profont10_tr);
      u8g2_DrawStr(&u8g2, 78, 11, "SAVE TO");
      u8g2_SendBuffer(&u8g2);
    }
  }
}
void handleprstinit3()
{
  currentTimepreset1 = HAL_GetTick();
  if (currentTimepreset1 - lastBlinkTime >= 600) // 250 ms delay
  {
    lastBlinkTime = currentTimepreset1;
    displayOn = !displayOn; // Toggle display state

    if (displayOn)
    {
      u8g2_ClearBuffer(&u8g2);
      u8g2_SetBitmapMode(&u8g2, 1);
      u8g2_SetFontMode(&u8g2, 1);
      u8g2_DrawBox(&u8g2, 0, 0, 64, 64);
      u8g2_SetDrawColor(&u8g2, 2);
      u8g2_SetFont(&u8g2, u8g2_font_profont29_tr);
      u8g2_DrawStr(&u8g2, 10, 55, "SET");
      u8g2_DrawStr(&u8g2, 10, 28, "PRE");
      u8g2_DrawStr(&u8g2, 90, 43, "3");
      u8g2_SetDrawColor(&u8g2, 1);
      u8g2_SetFont(&u8g2, u8g2_font_profont10_tr);
      u8g2_DrawStr(&u8g2, 78, 11, "SAVE TO");
      u8g2_SendBuffer(&u8g2);
    }
    else
    {
      u8g2_ClearBuffer(&u8g2);
      u8g2_SetBitmapMode(&u8g2, 1);
      u8g2_SetFontMode(&u8g2, 1);
      u8g2_DrawBox(&u8g2, 0, 0, 64, 64);
      u8g2_SetDrawColor(&u8g2, 2);
      u8g2_SetFont(&u8g2, u8g2_font_profont29_tr);
      u8g2_DrawStr(&u8g2, 10, 55, "SET");
      u8g2_DrawStr(&u8g2, 10, 28, "PRE");
      u8g2_SetDrawColor(&u8g2, 1);
      u8g2_DrawBox(&u8g2, 80, 19, 32, 29);
      u8g2_SetDrawColor(&u8g2, 2);
      u8g2_DrawStr(&u8g2, 90, 43, "3");
      u8g2_SetDrawColor(&u8g2, 1);
      u8g2_SetFont(&u8g2, u8g2_font_profont10_tr);
      u8g2_DrawStr(&u8g2, 78, 11, "SAVE TO");
      u8g2_SendBuffer(&u8g2);
    }
  }
}
void Ex_prst_s1()
{
  // Logic for prst_s3
  u8g2_ClearBuffer(&u8g2);
  u8g2_SetBitmapMode(&u8g2, 1);
  u8g2_SetFontMode(&u8g2, 1);
  u8g2_SetDrawColor(&u8g2, 2);
  u8g2_SetFont(&u8g2, u8g2_font_profont29_tr);
  u8g2_DrawStr(&u8g2, 24, 42, "SAVED");
  u8g2_DrawBox(&u8g2, 17, 16, 94, 32);
  u8g2_SendBuffer(&u8g2);

  toWrite1[0] = (uint8_t)(encoder_position1 >> 8);
  toWrite1[1] = (uint8_t)(encoder_position1 & 0xFF);
  toWrite1[2] = (uint8_t)(encoder_position2 >> 8);
  toWrite1[3] = (uint8_t)(encoder_position2 & 0xFF);
  toWrite1[4] = (uint8_t)(encoder_position3 >> 8);
  toWrite1[5] = (uint8_t)(encoder_position3 & 0xFF);

  HAL_I2C_Mem_Write(&hi2c1, EEPROM_ADDR, 0, 2, toWrite1, sizeof(toWrite1), 1000);
  DWT_Delay_ms(1500);
  currentState = MAIN;
}
void Ex_prst_s2()
{
  // Logic for prst_s3
  u8g2_ClearBuffer(&u8g2);
  u8g2_SetBitmapMode(&u8g2, 1);
  u8g2_SetFontMode(&u8g2, 1);
  u8g2_SetDrawColor(&u8g2, 2);
  u8g2_SetFont(&u8g2, u8g2_font_profont29_tr);
  u8g2_DrawStr(&u8g2, 24, 42, "SAVED");
  u8g2_DrawBox(&u8g2, 17, 16, 94, 32);
  u8g2_SendBuffer(&u8g2);

  toWrite2[0] = (uint8_t)(encoder_position1 >> 8);
  toWrite2[1] = (uint8_t)(encoder_position1 & 0xFF);
  toWrite2[2] = (uint8_t)(encoder_position2 >> 8);
  toWrite2[3] = (uint8_t)(encoder_position2 & 0xFF);
  toWrite2[4] = (uint8_t)(encoder_position3 >> 8);
  toWrite2[5] = (uint8_t)(encoder_position3 & 0xFF);

  HAL_I2C_Mem_Write(&hi2c1, EEPROM_ADDR, 64, 2, toWrite2, sizeof(toWrite2), 1000);
  DWT_Delay_ms(1500);
  currentState = MAIN;
}
void Ex_prst_s3()
{
  // Logic for prst_s3
  u8g2_ClearBuffer(&u8g2);
  u8g2_SetBitmapMode(&u8g2, 1);
  u8g2_SetFontMode(&u8g2, 1);
  u8g2_SetDrawColor(&u8g2, 2);
  u8g2_SetFont(&u8g2, u8g2_font_profont29_tr);
  u8g2_DrawStr(&u8g2, 24, 42, "SAVED");
  u8g2_DrawBox(&u8g2, 17, 16, 94, 32);
  u8g2_SendBuffer(&u8g2);

  toWrite3[0] = (uint8_t)(encoder_position1 >> 8);
  toWrite3[1] = (uint8_t)(encoder_position1 & 0xFF);
  toWrite3[2] = (uint8_t)(encoder_position2 >> 8);
  toWrite3[3] = (uint8_t)(encoder_position2 & 0xFF);
  toWrite3[4] = (uint8_t)(encoder_position3 >> 8);
  toWrite3[5] = (uint8_t)(encoder_position3 & 0xFF);

  HAL_I2C_Mem_Write(&hi2c1, EEPROM_ADDR, 128, 2, toWrite3, sizeof(toWrite3), 1000);
  DWT_Delay_ms(1500);
  currentState = MAIN;
}
void handle_MAIN()
{
  static const uint8_t image_ButtonLeft_bits[] = {0x08, 0x0c, 0x0e, 0x0f, 0x0e, 0x0c, 0x08};
  static const uint8_t image_ButtonRight_bits[] = {0x01, 0x03, 0x07, 0x0f, 0x07, 0x03, 0x01};
  u8g2_ClearBuffer(&u8g2);
  u8g2_SetBitmapMode(&u8g2, 1);
  u8g2_SetFontMode(&u8g2, 1);
  u8g2_SetFont(&u8g2, u8g2_font_profont12_tr);
  u8g2_DrawStr(&u8g2, 5, 25, "GAIN");
  u8g2_DrawLine(&u8g2, 127, 10, 0, 10);
  u8g2_DrawBox(&u8g2, 40, 16, mapped_value1, 10);
  u8g2_DrawBox(&u8g2, 40, 33, mapped_value2, 10);
  u8g2_DrawBox(&u8g2, 40, 51, mapped_value3, 10);
  u8g2_DrawStr(&u8g2, 5, 42, "TONE");
  u8g2_DrawStr(&u8g2, 5, 60, "LEVEL");
  u8g2_SetFont(&u8g2, u8g2_font_4x6_tr);
  u8g2_DrawStr(&u8g2, 95, 7, "THE.IB");
  u8g2_SetDrawColor(&u8g2, 2);
  u8g2_DrawBox(&u8g2, 94, 1, 25, 7);
  u8g2_SetFont(&u8g2, u8g2_font_profont10_tr);
  u8g2_DrawStr(&u8g2, 10, 8, "A");
  u8g2_DrawBox(&u8g2, 8, 1, 8, 8);
  u8g2_SetDrawColor(&u8g2, 1);
  u8g2_DrawLine(&u8g2, 106, 16, 106, 25);
  u8g2_DrawLine(&u8g2, 106, 33, 106, 42);
  u8g2_DrawLine(&u8g2, 106, 51, 106, 60);
  u8g2_DrawXBM(&u8g2, 0, 1, 4, 7, image_ButtonLeft_bits);
  u8g2_DrawXBM(&u8g2, 124, 1, 4, 7, image_ButtonRight_bits);
  u8g2_SendBuffer(&u8g2);
}
void handle_STATE_1()
{
  u8g2_ClearBuffer(&u8g2);
  u8g2_SetBitmapMode(&u8g2, 1);
  u8g2_SetFontMode(&u8g2, 1);
  u8g2_SetDrawColor(&u8g2, 2);
  u8g2_DrawBox(&u8g2, 0, 0, 128, 30);
  u8g2_DrawBox(&u8g2, 0, 34, ClampValue(encoder_position1, 1, 128), 30);
  u8g2_SetFont(&u8g2, u8g2_font_profont29_tr);
  u8g2_DrawStr(&u8g2, 34, 25, "GAIN");
  u8g2_SendBuffer(&u8g2);
}
void handle_STATE_2()
{
  u8g2_ClearBuffer(&u8g2);
  u8g2_SetBitmapMode(&u8g2, 1);
  u8g2_SetFontMode(&u8g2, 1);
  u8g2_SetDrawColor(&u8g2, 2);
  u8g2_DrawBox(&u8g2, 0, 0, 128, 30);
  u8g2_DrawBox(&u8g2, 0, 34, ClampValue(encoder_position2, 1, 128), 30);
  u8g2_SetFont(&u8g2, u8g2_font_profont29_tr);
  u8g2_DrawStr(&u8g2, 32, 25, "TONE");
  u8g2_SendBuffer(&u8g2);
}
void handle_STATE_3()
{
  u8g2_ClearBuffer(&u8g2);
  u8g2_SetBitmapMode(&u8g2, 1);
  u8g2_SetFontMode(&u8g2, 1);
  u8g2_SetDrawColor(&u8g2, 2);
  u8g2_DrawBox(&u8g2, 0, 0, 128, 30);
  u8g2_DrawBox(&u8g2, 0, 34, ClampValue(encoder_position3, 1, 128), 30);
  u8g2_SetFont(&u8g2, u8g2_font_profont29_tr);
  u8g2_DrawStr(&u8g2, 27, 25, "LEVEL");
  u8g2_SendBuffer(&u8g2);
}
void GP_X9C104_UP()
{
  HAL_GPIO_WritePin(GPIOB, CS_ALL_Pin, GPIO_PIN_RESET);
  HAL_GPIO_WritePin(GPIOB, GP_UD_Pin, GPIO_PIN_SET);
}
void GP_X9C104_DOWN()
{
  HAL_GPIO_WritePin(GPIOB, CS_ALL_Pin, GPIO_PIN_RESET);
  HAL_GPIO_WritePin(GPIOB, GP_UD_Pin, GPIO_PIN_RESET);
}
void TP_X9C104_UP()
{
  HAL_GPIO_WritePin(GPIOB, CS_ALL_Pin, GPIO_PIN_RESET);
  HAL_GPIO_WritePin(GPIOB, TP_UD_Pin, GPIO_PIN_SET);
}
void TP_X9C104_DOWN()
{
  HAL_GPIO_WritePin(GPIOB, CS_ALL_Pin, GPIO_PIN_RESET);
  HAL_GPIO_WritePin(GPIOB, TP_UD_Pin, GPIO_PIN_RESET);
}
void LP_X9C104_UP()
{
  HAL_GPIO_WritePin(GPIOB, CS_ALL_Pin, GPIO_PIN_RESET);
  HAL_GPIO_WritePin(GPIOB, LP_UD_Pin, GPIO_PIN_SET);
}
void LP_X9C104_DOWN()
{
  HAL_GPIO_WritePin(GPIOB, CS_ALL_Pin, GPIO_PIN_RESET);
  HAL_GPIO_WritePin(GPIOB, LP_UD_Pin, GPIO_PIN_RESET);
}
void GP_step(int16_t GP_steps)
{
  // Move the wiper by toggling INC
  for (uint8_t i = 0; i < GP_steps; i++)
  {
    HAL_GPIO_WritePin(GPIOB, GP_INC_Pin, GPIO_PIN_RESET); // INC LOW
    DWT_Delay_us(4);                                      // Small delay
    HAL_GPIO_WritePin(GPIOB, GP_INC_Pin, GPIO_PIN_SET);   // INC HIGH
    DWT_Delay_us(10);                                     // Small delay
  }
}
void TP_step(int16_t TP_steps)
{
  // Move the wiper by toggling INC
  for (uint8_t i = 0; i < TP_steps; i++)
  {
    HAL_GPIO_WritePin(GPIOB, TP_INC_Pin, GPIO_PIN_RESET); // INC LOW
    DWT_Delay_us(4);                                      // Small delay
    HAL_GPIO_WritePin(GPIOB, TP_INC_Pin, GPIO_PIN_SET);   // INC HIGH
    DWT_Delay_us(10);                                     // Small delay
  }
}
void LP_step(int16_t LP_steps)
{
  // Move the wiper by toggling INC
  for (uint8_t i = 0; i < LP_steps; i++)
  {
    HAL_GPIO_WritePin(GPIOB, LP_INC_Pin, GPIO_PIN_RESET); // INC LOW
    DWT_Delay_us(4);                                      // Small delay
    HAL_GPIO_WritePin(GPIOB, LP_INC_Pin, GPIO_PIN_SET);   // INC HIGH
    DWT_Delay_us(10);                                     // Small delay
  }
}
void updateWiperPosition(int16_t GP_map_v, int16_t TP_map_v, int16_t LP_map_v)
{
  GP_steps = GP_map_v - prev_enc_pos1;
  TP_steps = TP_map_v - prev_enc_pos2;
  LP_steps = LP_map_v - prev_enc_pos3;

  if (GP_steps > 0)
  {
    GP_X9C104_UP();
    GP_step(GP_steps); // Increment wiper position
  }
  else if (GP_steps < 0)
  {
    GP_X9C104_DOWN();
    GP_step(-GP_steps); // Decrement wiper position
  }

  if (TP_steps > 0)
  {
    TP_X9C104_UP();
    TP_step(TP_steps); // Increment wiper position
  }
  else if (TP_steps < 0)
  {
    TP_X9C104_DOWN();
    TP_step(-TP_steps); // Decrement wiper position
  }

  if (LP_steps > 0)
  {
    LP_X9C104_UP();
    LP_step(LP_steps); // Increment wiper position
  }
  else if (LP_steps < 0)
  {
    LP_X9C104_DOWN();
    LP_step(-LP_steps); // Decrement wiper position
  }

  prev_enc_pos1 = GP_map_v; // Update the previous encoder position
  prev_enc_pos2 = TP_map_v; // Update the previous encoder position
  prev_enc_pos3 = LP_map_v;
  // Update the previous encoder position
}
void X9C104_ZERO()
{
  GP_X9C104_DOWN();
  GP_step(100);
  TP_X9C104_DOWN();
  TP_step(100);
  LP_X9C104_DOWN();
  LP_step(100);
}
void handle_RD_PRST_1()
{
  // HAL_I2C_Mem_Read(I2C_HandleTypeDef *hi2c, uint16_t DevAddress, uint16_t MemAddress,
  //   uint16_t MemAddSize, uint8_t *pData, uint16_t Size, uint32_t Timeout);
  HAL_I2C_Mem_Read(&hi2c1, EEPROM_ADDR, 0, 2, toRead1, sizeof(toRead1), 1000);

  encoder1_binary = (uint16_t)(toRead1[0] << 8) | toRead1[1];
  encoder2_binary = (uint16_t)(toRead1[2] << 8) | toRead1[3];
  encoder3_binary = (uint16_t)(toRead1[4] << 8) | toRead1[5];

  __HAL_TIM_SET_COUNTER(&htim1, encoder1_binary);
  __HAL_TIM_SET_COUNTER(&htim2, encoder2_binary);
  __HAL_TIM_SET_COUNTER(&htim3, encoder3_binary);

  RD_PRST_state = true;
  currentState = MAIN;
}
void handle_RD_PRST_2()
{
  HAL_I2C_Mem_Read(&hi2c1, EEPROM_ADDR, 64, 2, toRead2, sizeof(toRead2), 1000);

  encoder1_binary = (uint16_t)(toRead2[0] << 8) | toRead2[1];
  encoder2_binary = (uint16_t)(toRead2[2] << 8) | toRead2[3];
  encoder3_binary = (uint16_t)(toRead2[4] << 8) | toRead2[5];

  __HAL_TIM_SET_COUNTER(&htim1, encoder1_binary);
  __HAL_TIM_SET_COUNTER(&htim2, encoder2_binary);
  __HAL_TIM_SET_COUNTER(&htim3, encoder3_binary);
  RD_PRST_state = true;
  currentState = MAIN;
}
void handle_RD_PRST_3()
{
  HAL_I2C_Mem_Read(&hi2c1, EEPROM_ADDR, 128, 2, toRead3, sizeof(toRead3), 1000);

  encoder1_binary = (uint16_t)(toRead3[0] << 8) | toRead3[1];
  encoder2_binary = (uint16_t)(toRead3[2] << 8) | toRead3[3];
  encoder3_binary = (uint16_t)(toRead3[4] << 8) | toRead3[5];

  __HAL_TIM_SET_COUNTER(&htim1, encoder1_binary);
  __HAL_TIM_SET_COUNTER(&htim2, encoder2_binary);
  __HAL_TIM_SET_COUNTER(&htim3, encoder3_binary);
  RD_PRST_state = true;
  currentState = MAIN;
}
void Preset_Bank_select()
{
  if (preset_bank == 1)
  {
    previesly_pressed = 2222;
    currentState = BANK_1;
  }
  else if (preset_bank == 2)
  {
    currentState = BANK_2;
  }
  else if (preset_bank == 3)
  {
    currentState = BANK_3;
  }
  else if (preset_bank == 4)
  {
    currentState = BANK_4;
  }
  else if (preset_bank == 5)
  {
    currentState = BANK_5;
  }
  else if (preset_bank == 6)
  {
    currentState = BANK_6;
  }
  else if (preset_bank == 7)
  {
    currentState = BANK_7;
  }
  else if (preset_bank == 8)
  {
    currentState = BANK_8;
  }
}

void handle_BANK_1()
{
  static const uint8_t image_Layer_10_bits[] = {0xe0, 0x01, 0x00, 0x00, 0xfe, 0x07, 0x00, 0x00, 0xe0, 0x07, 0x00, 0x00, 0xff,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 0x07, 0x38};
  u8g2_ClearBuffer(&u8g2);
  u8g2_SetBitmapMode(&u8g2, 1);
  u8g2_SetFontMode(&u8g2, 1);
  u8g2_DrawBox(&u8g2, 0, 0, 32, 32);
  u8g2_SetDrawColor(&u8g2, 2);
  u8g2_DrawXBM(&u8g2, 9, 7, 110, 50, image_Layer_10_bits);
  u8g2_SendBuffer(&u8g2);
}
void handle_BANK_2()
{
  static const uint8_t image_Layer_10_bits[] = {0xe0, 0x01, 0x00, 0x00, 0xfe, 0x07, 0x00, 0x00, 0xe0, 0x07, 0x00, 0x00, 0xff,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 0x07, 0x38};
  u8g2_ClearBuffer(&u8g2);
  u8g2_SetBitmapMode(&u8g2, 1);
  u8g2_SetFontMode(&u8g2, 1);
  u8g2_DrawBox(&u8g2, 32, 0, 32, 32);
  u8g2_SetDrawColor(&u8g2, 2);
  u8g2_DrawXBM(&u8g2, 9, 7, 110, 50, image_Layer_10_bits);
  u8g2_SendBuffer(&u8g2);
}
void handle_BANK_3()
{
  static const uint8_t image_Layer_10_bits[] = {0xe0, 0x01, 0x00, 0x00, 0xfe, 0x07, 0x00, 0x00, 0xe0, 0x07, 0x00, 0x00, 0xff,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 0x07, 0x38};
  u8g2_ClearBuffer(&u8g2);
  u8g2_SetBitmapMode(&u8g2, 1);
  u8g2_SetFontMode(&u8g2, 1);
  u8g2_DrawBox(&u8g2, 64, 0, 32, 32);
  u8g2_SetDrawColor(&u8g2, 2);
  u8g2_DrawXBM(&u8g2, 9, 7, 110, 50, image_Layer_10_bits);
  u8g2_SendBuffer(&u8g2);
}

void handle_BANK_4()
{
  static const uint8_t image_Layer_10_bits[] = {0xe0, 0x01, 0x00, 0x00, 0xfe, 0x07, 0x00, 0x00, 0xe0, 0x07, 0x00, 0x00, 0xff,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 0x07, 0x38};
  u8g2_ClearBuffer(&u8g2);
  u8g2_SetBitmapMode(&u8g2, 1);
  u8g2_SetFontMode(&u8g2, 1);
  u8g2_DrawBox(&u8g2, 96, 0, 32, 32);
  u8g2_SetDrawColor(&u8g2, 2);
  u8g2_DrawXBM(&u8g2, 9, 7, 110, 50, image_Layer_10_bits);
  u8g2_SendBuffer(&u8g2);
}
void handle_BANK_5()
{
  static const uint8_t image_Layer_10_bits[] = {0xe0, 0x01, 0x00, 0x00, 0xfe, 0x07, 0x00, 0x00, 0xe0, 0x07, 0x00, 0x00, 0xff,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 0x07, 0x38};
  u8g2_ClearBuffer(&u8g2);
  u8g2_SetBitmapMode(&u8g2, 1);
  u8g2_SetFontMode(&u8g2, 1);
  u8g2_DrawBox(&u8g2, 0, 32, 32, 32);
  u8g2_SetDrawColor(&u8g2, 2);
  u8g2_DrawXBM(&u8g2, 9, 7, 110, 50, image_Layer_10_bits);
  u8g2_SendBuffer(&u8g2);
}
void handle_BANK_6()
{
  static const uint8_t image_Layer_10_bits[] = {0xe0, 0x01, 0x00, 0x00, 0xfe, 0x07, 0x00, 0x00, 0xe0, 0x07, 0x00, 0x00, 0xff,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 0x07, 0x38};
  u8g2_ClearBuffer(&u8g2);
  u8g2_SetBitmapMode(&u8g2, 1);
  u8g2_SetFontMode(&u8g2, 1);
  u8g2_DrawBox(&u8g2, 32, 32, 32, 32);
  u8g2_SetDrawColor(&u8g2, 2);
  u8g2_DrawXBM(&u8g2, 9, 7, 110, 50, image_Layer_10_bits);
  u8g2_SendBuffer(&u8g2);
}
void handle_BANK_7()
{
  static const uint8_t image_Layer_10_bits[] = {0xe0, 0x01, 0x00, 0x00, 0xfe, 0x07, 0x00, 0x00, 0xe0, 0x07, 0x00, 0x00, 0xff,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 0x07, 0x38};
  u8g2_ClearBuffer(&u8g2);
  u8g2_SetBitmapMode(&u8g2, 1);
  u8g2_SetFontMode(&u8g2, 1);
  u8g2_DrawBox(&u8g2, 64, 32, 32, 32);
  u8g2_SetDrawColor(&u8g2, 2);
  u8g2_DrawXBM(&u8g2, 9, 7, 110, 50, image_Layer_10_bits);
  u8g2_SendBuffer(&u8g2);
}
void handle_BANK_8()
{
  static const uint8_t image_Layer_10_bits[] = {0xe0, 0x01, 0x00, 0x00, 0xfe, 0x07, 0x00, 0x00, 0xe0, 0x07, 0x00, 0x00, 0xff,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 0x07, 0x38};
  u8g2_ClearBuffer(&u8g2);
  u8g2_SetBitmapMode(&u8g2, 1);
  u8g2_SetFontMode(&u8g2, 1);
  u8g2_DrawBox(&u8g2, 96, 32, 32, 32);
  u8g2_SetDrawColor(&u8g2, 2);
  u8g2_DrawXBM(&u8g2, 9, 7, 110, 50, image_Layer_10_bits);
  u8g2_SendBuffer(&u8g2);
}
/* USER CODE END 0 */

/**
 * @brief  The application entry point.
 * @retval int
 */
int main(void)
{

  /* USER CODE BEGIN 1 */

  /* USER CODE END 1 */

  /* MCU Configuration--------------------------------------------------------*/

  /* Reset of all peripherals, Initializes the Flash interface and the Systick. */
  HAL_Init();

  /* USER CODE BEGIN Init */

  /* USER CODE END Init */

  /* Configure the system clock */
  SystemClock_Config();

  /* USER CODE BEGIN SysInit */

  /* USER CODE END SysInit */

  /* Initialize all configured peripherals */
  MX_GPIO_Init();
  MX_TIM2_Init();
  MX_TIM3_Init();
  MX_TIM1_Init();
  MX_I2C1_Init();
  /* USER CODE BEGIN 2 */
  DWT_Delay_Init();
  X9C104_ZERO();
  HAL_TIM_Encoder_Start(&htim1, TIM_CHANNEL_ALL);
  HAL_TIM_Encoder_Start(&htim2, TIM_CHANNEL_ALL);
  HAL_TIM_Encoder_Start(&htim3, TIM_CHANNEL_ALL);

  lastActivityTime = HAL_GetTick();

  u8g2_Setup_ssd1306_i2c_128x64_noname_f(
      &u8g2,
      U8G2_R0,
      u8x8_byte_hw_i2c_stm32,
      u8x8_gpio_and_delay_stm32);

  // Initialize display
  u8g2_InitDisplay(&u8g2);
  u8g2_SetPowerSave(&u8g2, 0);
  static const uint8_t image_theib_idp2_bits[] = {0x00, 0x00, 0x00, 0x00, 0x00, 0x00, 0x00, 0x00, 0x00, 0x00, 0x00, 0x00, 0x00,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 0x00, 0x00};
  u8g2_ClearBuffer(&u8g2);
  u8g2_SetBitmapMode(&u8g2, 1);
  u8g2_SetFontMode(&u8g2, 1);

  u8g2_SetDrawColor(&u8g2, 2);
  u8g2_DrawBox(&u8g2, 6, 10, 117, 41);

  u8g2_DrawXBM(&u8g2, 9, 11, 109, 42, image_theib_idp2_bits);

  u8g2_SendBuffer(&u8g2);
  DWT_Delay_ms(2000);
  if (HAL_GPIO_ReadPin(SW_3PDT_EXTI_GPIO_Port, SW_3PDT_EXTI_Pin) == GPIO_PIN_RESET)
  {
    system_locked = 0;
    currentState = MAIN;
  }
  else
  {
    system_locked = 1;
    currentState = bypassed;
  }
  /* USER CODE END 2 */

  /* Infinite loop */
  /* USER CODE BEGIN WHILE */
  while (1)
  {
    /* USER CODE END WHILE */

    encoder_position1 = (int16_t)__HAL_TIM_GET_COUNTER(&htim1);
    encoder_position2 = (int16_t)__HAL_TIM_GET_COUNTER(&htim2);
    encoder_position3 = (int16_t)__HAL_TIM_GET_COUNTER(&htim3);

    if (encoder_position1 < 0)
    {
      __HAL_TIM_SET_COUNTER(&htim1, 0); // Reset the encoder counter to 0
    }
    if (encoder_position1 > 128)
    {
      __HAL_TIM_SET_COUNTER(&htim1, 128); // Reset the encoder counter to 128
    }
    if (encoder_position2 < 0)
    {
      __HAL_TIM_SET_COUNTER(&htim2, 0); // Reset the encoder counter to 0
    }
    if (encoder_position2 > 128)
    {
      __HAL_TIM_SET_COUNTER(&htim2, 128); // Reset the encoder counter to 128
    }
    if (encoder_position3 < 0)
    {
      __HAL_TIM_SET_COUNTER(&htim3, 0); // Reset the encoder counter to 0
    }
    if (encoder_position3 > 128)
    {
      __HAL_TIM_SET_COUNTER(&htim3, 128); // Reset the encoder counter to 128
    }

    mapped_value1 = MapValue(encoder_position1, 0, 128, 2, 66);
    mapped_value2 = MapValue(encoder_position2, 0, 128, 2, 66);
    mapped_value3 = MapValue(encoder_position3, 0, 128, 2, 66);

    GP_map_v = MapValue(encoder_position1, 0, 128, 0, 100);
    TP_map_v = MapValue(encoder_position2, 0, 128, 0, 100);
    LP_map_v = MapValue(encoder_position3, 0, 128, 0, 100);
    // Update state based on encoder positions
    UpdateState(&currentState, encoder_position1, encoder_position2, encoder_position3);

    if ((HAL_GetTick() - lastActivityTime > 1000) && (currentState != prstinit1) && (currentState != prstinit2) && (currentState != prstinit3) && (currentState != prst_s1) && (currentState != prst_s2) && (currentState != prst_s3) && (currentState != RD_PRST_1) && (currentState != RD_PRST_2) && (currentState != RD_PRST_3) && (currentState != BANK_1) && (currentState != BANK_2) &&
        (currentState != BANK_3) && (currentState != BANK_4) &&
        (currentState != BANK_5) && (currentState != BANK_6) &&
        (currentState != BANK_7) && (currentState != BANK_8) && (currentState != bypassed))
    {
      // If no activity for 1 second, go to MAIN state
      currentState = MAIN;
    }

    // Add any additional logic based on the current state here
    updateWiperPosition(GP_map_v, TP_map_v, LP_map_v);
    switch (currentState)
    {
    case MAIN:
      static const uint8_t image_ButtonLeft_bits[] = {0x08, 0x0c, 0x0e, 0x0f, 0x0e, 0x0c, 0x08};
      static const uint8_t image_ButtonRight_bits[] = {0x01, 0x03, 0x07, 0x0f, 0x07, 0x03, 0x01};
      u8g2_ClearBuffer(&u8g2);
      u8g2_SetBitmapMode(&u8g2, 1);
      u8g2_SetFontMode(&u8g2, 1);
      u8g2_SetFont(&u8g2, u8g2_font_profont12_tr);
      u8g2_DrawStr(&u8g2, 5, 25, "GAIN");
      u8g2_DrawLine(&u8g2, 127, 10, 0, 10);
      u8g2_DrawBox(&u8g2, 40, 16, mapped_value1, 10);
      u8g2_DrawBox(&u8g2, 40, 33, mapped_value2, 10);
      u8g2_DrawBox(&u8g2, 40, 51, mapped_value3, 10);
      u8g2_DrawStr(&u8g2, 5, 42, "TONE");
      u8g2_DrawStr(&u8g2, 5, 60, "LEVEL");
      u8g2_SetFont(&u8g2, u8g2_font_4x6_tr);
      u8g2_DrawStr(&u8g2, 95, 7, "THE.IB");
      u8g2_SetDrawColor(&u8g2, 2);
      u8g2_DrawBox(&u8g2, 94, 1, 25, 7);
      u8g2_SetFont(&u8g2, u8g2_font_profont10_tr);
      u8g2_DrawStr(&u8g2, 10, 8, "BANK");
      char bankLetter[8] = {0}; // Buffer to hold the bank letter
      if (preset_bank == 0)
      {
        u8g2_DrawStr(&u8g2, 34, 8, "A");
      }
      else
      {
        bankLetter[0] = 'A' + (preset_bank - 1); // Calculate the letter based on preset_bank
        u8g2_DrawStr(&u8g2, 34, 8, bankLetter);
      }

      u8g2_DrawBox(&u8g2, 8, 1, 32, 8);
      u8g2_SetDrawColor(&u8g2, 1);
      u8g2_DrawLine(&u8g2, 106, 16, 106, 25);
      u8g2_DrawLine(&u8g2, 106, 33, 106, 42);
      u8g2_DrawLine(&u8g2, 106, 51, 106, 60);
      u8g2_DrawXBM(&u8g2, 0, 1, 4, 7, image_ButtonLeft_bits);
      u8g2_DrawXBM(&u8g2, 124, 1, 4, 7, image_ButtonRight_bits);
      u8g2_SendBuffer(&u8g2);
      break;
    case STATE1:
      // Logic for STATE1
      u8g2_ClearBuffer(&u8g2);
      u8g2_SetBitmapMode(&u8g2, 1);
      u8g2_SetFontMode(&u8g2, 1);
      u8g2_SetDrawColor(&u8g2, 2);
      u8g2_DrawBox(&u8g2, 0, 0, 128, 30);
      u8g2_DrawBox(&u8g2, 0, 34, ClampValue(encoder_position1, 1, 128), 30);
      u8g2_SetFont(&u8g2, u8g2_font_profont29_tr);
      u8g2_DrawStr(&u8g2, 34, 25, "GAIN");
      u8g2_SendBuffer(&u8g2);
      break;
    case STATE2:
      u8g2_ClearBuffer(&u8g2);
      u8g2_SetBitmapMode(&u8g2, 1);
      u8g2_SetFontMode(&u8g2, 1);
      u8g2_SetDrawColor(&u8g2, 2);
      u8g2_DrawBox(&u8g2, 0, 0, 128, 30);
      u8g2_DrawBox(&u8g2, 0, 34, ClampValue(encoder_position2, 1, 128), 30);
      u8g2_SetFont(&u8g2, u8g2_font_profont29_tr);
      u8g2_DrawStr(&u8g2, 32, 25, "TONE");
      u8g2_SendBuffer(&u8g2);
      break;
    case STATE3:
      // Logic for STATE3
      u8g2_ClearBuffer(&u8g2);
      u8g2_SetBitmapMode(&u8g2, 1);
      u8g2_SetFontMode(&u8g2, 1);
      u8g2_SetDrawColor(&u8g2, 2);
      u8g2_DrawBox(&u8g2, 0, 0, 128, 30);
      u8g2_DrawBox(&u8g2, 0, 34, ClampValue(encoder_position3, 1, 128), 30);
      u8g2_SetFont(&u8g2, u8g2_font_profont29_tr);
      u8g2_DrawStr(&u8g2, 27, 25, "LEVEL");
      u8g2_SendBuffer(&u8g2);
      break;
    case prstinit1:
      handleprstinit1();
      break;
    case prstinit2:
      // Logic for prstinit1
      handleprstinit2();
      break;
    case prstinit3:
      // Logic for prstinit1
      handleprstinit3();
      break;
    case prst_s1:
      Ex_prst_s1();
      break;
    case prst_s2:
      Ex_prst_s2();
      break;
    case prst_s3:
      Ex_prst_s3();
      break;
    case RD_PRST_1:
      handle_RD_PRST_1();
      // Logic for RD_PRST_1
      break;
    case RD_PRST_2:
      handle_RD_PRST_2();
      // Logic for RD_PRST_2
      break;
    case RD_PRST_3:
      handle_RD_PRST_3();
      // Logic for RD_PRST_3
      break;
    case BANK_1:
      previesly_pressed = 1111;
      handle_BANK_1();
      previesly_pressed = 3333;
      break;
    case BANK_2:
      handle_BANK_2();
      break;
    case BANK_3:
      handle_BANK_3();
      break;
    case BANK_4:
      handle_BANK_4();
      break;
    case BANK_5:

      handle_BANK_5();
      break;
    case BANK_6:
      handle_BANK_6();
      break;
    case BANK_7:
      handle_BANK_7();
      break;
    case BANK_8:
      handle_BANK_8();
      break;
    case bypassed:
      currentTimepreset1 = HAL_GetTick();
      if (currentTimepreset1 - lastBlinkTime >= 600) // 250 ms delay
      {
        lastBlinkTime = currentTimepreset1;
        displayOn = !displayOn; // Toggle display state

        if (displayOn)
        {
          static const uint8_t image_unnamed__1__bits[] = {0x00, 0x00, 0x00, 0x00, 0x00, 0x00, 0x00, 0x00, 0x00, 0x00, 0x00, 0x00, 0x00,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 0x00, 0x00};
          u8g2_ClearBuffer(&u8g2);
          u8g2_SetBitmapMode(&u8g2, 1);
          u8g2_SetFontMode(&u8g2, 1);

          u8g2_DrawXBM(&u8g2, 7, 20, 114, 32, image_unnamed__1__bits);

          u8g2_SetDrawColor(&u8g2, 2);
          u8g2_DrawBox(&u8g2, 0, 1, 128, 64);

          u8g2_SendBuffer(&u8g2);
        }
        else
        {
          static const uint8_t image_unnamed__1__bits[] = {0x00, 0x00, 0x00, 0x00, 0x00, 0x00, 0x00, 0x00, 0x00, 0x00, 0x00, 0x00, 0x00,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 0x00, 0x00};
          u8g2_ClearBuffer(&u8g2);
          u8g2_SetBitmapMode(&u8g2, 1);
          u8g2_SetFontMode(&u8g2, 1);

          u8g2_DrawXBM(&u8g2, 7, 20, 114, 32, image_unnamed__1__bits);

          u8g2_SendBuffer(&u8g2);
        }
      }
      break;
    }

    /* USER CODE BEGIN 3 */
  }
  /* USER CODE END 3 */
}

/**
 * @brief System Clock Configuration
 * @retval None
 */
void SystemClock_Config(void)
{
  RCC_OscInitTypeDef RCC_OscInitStruct = {0};
  RCC_ClkInitTypeDef RCC_ClkInitStruct = {0};

  /** Initializes the RCC Oscillators according to the specified parameters
   * in the RCC_OscInitTypeDef structure.
   */
  RCC_OscInitStruct.OscillatorType = RCC_OSCILLATORTYPE_HSE;
  RCC_OscInitStruct.HSEState = RCC_HSE_ON;
  RCC_OscInitStruct.HSEPredivValue = RCC_HSE_PREDIV_DIV2;
  RCC_OscInitStruct.HSIState = RCC_HSI_ON;
  RCC_OscInitStruct.PLL.PLLState = RCC_PLL_ON;
  RCC_OscInitStruct.PLL.PLLSource = RCC_PLLSOURCE_HSE;
  RCC_OscInitStruct.PLL.PLLMUL = RCC_PLL_MUL9;
  if (HAL_RCC_OscConfig(&RCC_OscInitStruct) != HAL_OK)
  {
    Error_Handler();
  }

  /** Initializes the CPU, AHB and APB buses clocks
   */
  RCC_ClkInitStruct.ClockType = RCC_CLOCKTYPE_HCLK | RCC_CLOCKTYPE_SYSCLK | RCC_CLOCKTYPE_PCLK1 | RCC_CLOCKTYPE_PCLK2;
  RCC_ClkInitStruct.SYSCLKSource = RCC_SYSCLKSOURCE_PLLCLK;
  RCC_ClkInitStruct.AHBCLKDivider = RCC_SYSCLK_DIV1;
  RCC_ClkInitStruct.APB1CLKDivider = RCC_HCLK_DIV2;
  RCC_ClkInitStruct.APB2CLKDivider = RCC_HCLK_DIV1;

  if (HAL_RCC_ClockConfig(&RCC_ClkInitStruct, FLASH_LATENCY_2) != HAL_OK)
  {
    Error_Handler();
  }
}

/**
 * @brief I2C1 Initialization Function
 * @param None
 * @retval None
 */
static void MX_I2C1_Init(void)
{

  /* USER CODE BEGIN I2C1_Init 0 */

  /* USER CODE END I2C1_Init 0 */

  /* USER CODE BEGIN I2C1_Init 1 */

  /* USER CODE END I2C1_Init 1 */
  hi2c1.Instance = I2C1;
  hi2c1.Init.ClockSpeed = 400000;
  hi2c1.Init.DutyCycle = I2C_DUTYCYCLE_2;
  hi2c1.Init.OwnAddress1 = 0;
  hi2c1.Init.AddressingMode = I2C_ADDRESSINGMODE_7BIT;
  hi2c1.Init.DualAddressMode = I2C_DUALADDRESS_DISABLE;
  hi2c1.Init.OwnAddress2 = 0;
  hi2c1.Init.GeneralCallMode = I2C_GENERALCALL_DISABLE;
  hi2c1.Init.NoStretchMode = I2C_NOSTRETCH_DISABLE;
  if (HAL_I2C_Init(&hi2c1) != HAL_OK)
  {
    Error_Handler();
  }
  /* USER CODE BEGIN I2C1_Init 2 */

  /* USER CODE END I2C1_Init 2 */
}

/**
 * @brief TIM1 Initialization Function
 * @param None
 * @retval None
 */
static void MX_TIM1_Init(void)
{

  /* USER CODE BEGIN TIM1_Init 0 */

  /* USER CODE END TIM1_Init 0 */

  TIM_Encoder_InitTypeDef sConfig = {0};
  TIM_MasterConfigTypeDef sMasterConfig = {0};

  /* USER CODE BEGIN TIM1_Init 1 */

  /* USER CODE END TIM1_Init 1 */
  htim1.Instance = TIM1;
  htim1.Init.Prescaler = 0;
  htim1.Init.CounterMode = TIM_COUNTERMODE_UP;
  htim1.Init.Period = 65535;
  htim1.Init.ClockDivision = TIM_CLOCKDIVISION_DIV1;
  htim1.Init.RepetitionCounter = 0;
  htim1.Init.AutoReloadPreload = TIM_AUTORELOAD_PRELOAD_DISABLE;
  sConfig.EncoderMode = TIM_ENCODERMODE_TI12;
  sConfig.IC1Polarity = TIM_ICPOLARITY_RISING;
  sConfig.IC1Selection = TIM_ICSELECTION_DIRECTTI;
  sConfig.IC1Prescaler = TIM_ICPSC_DIV1;
  sConfig.IC1Filter = 0;
  sConfig.IC2Polarity = TIM_ICPOLARITY_RISING;
  sConfig.IC2Selection = TIM_ICSELECTION_DIRECTTI;
  sConfig.IC2Prescaler = TIM_ICPSC_DIV1;
  sConfig.IC2Filter = 0;
  if (HAL_TIM_Encoder_Init(&htim1, &sConfig) != HAL_OK)
  {
    Error_Handler();
  }
  sMasterConfig.MasterOutputTrigger = TIM_TRGO_RESET;
  sMasterConfig.MasterSlaveMode = TIM_MASTERSLAVEMODE_DISABLE;
  if (HAL_TIMEx_MasterConfigSynchronization(&htim1, &sMasterConfig) != HAL_OK)
  {
    Error_Handler();
  }
  /* USER CODE BEGIN TIM1_Init 2 */

  /* USER CODE END TIM1_Init 2 */
}

/**
 * @brief TIM2 Initialization Function
 * @param None
 * @retval None
 */
static void MX_TIM2_Init(void)
{

  /* USER CODE BEGIN TIM2_Init 0 */

  /* USER CODE END TIM2_Init 0 */

  TIM_Encoder_InitTypeDef sConfig = {0};
  TIM_MasterConfigTypeDef sMasterConfig = {0};

  /* USER CODE BEGIN TIM2_Init 1 */

  /* USER CODE END TIM2_Init 1 */
  htim2.Instance = TIM2;
  htim2.Init.Prescaler = 0;
  htim2.Init.CounterMode = TIM_COUNTERMODE_UP;
  htim2.Init.Period = 65535;
  htim2.Init.ClockDivision = TIM_CLOCKDIVISION_DIV1;
  htim2.Init.AutoReloadPreload = TIM_AUTORELOAD_PRELOAD_DISABLE;
  sConfig.EncoderMode = TIM_ENCODERMODE_TI12;
  sConfig.IC1Polarity = TIM_ICPOLARITY_RISING;
  sConfig.IC1Selection = TIM_ICSELECTION_DIRECTTI;
  sConfig.IC1Prescaler = TIM_ICPSC_DIV1;
  sConfig.IC1Filter = 2;
  sConfig.IC2Polarity = TIM_ICPOLARITY_RISING;
  sConfig.IC2Selection = TIM_ICSELECTION_DIRECTTI;
  sConfig.IC2Prescaler = TIM_ICPSC_DIV1;
  sConfig.IC2Filter = 2;
  if (HAL_TIM_Encoder_Init(&htim2, &sConfig) != HAL_OK)
  {
    Error_Handler();
  }
  sMasterConfig.MasterOutputTrigger = TIM_TRGO_RESET;
  sMasterConfig.MasterSlaveMode = TIM_MASTERSLAVEMODE_DISABLE;
  if (HAL_TIMEx_MasterConfigSynchronization(&htim2, &sMasterConfig) != HAL_OK)
  {
    Error_Handler();
  }
  /* USER CODE BEGIN TIM2_Init 2 */

  /* USER CODE END TIM2_Init 2 */
}

/**
 * @brief TIM3 Initialization Function
 * @param None
 * @retval None
 */
static void MX_TIM3_Init(void)
{

  /* USER CODE BEGIN TIM3_Init 0 */

  /* USER CODE END TIM3_Init 0 */

  TIM_Encoder_InitTypeDef sConfig = {0};
  TIM_MasterConfigTypeDef sMasterConfig = {0};

  /* USER CODE BEGIN TIM3_Init 1 */

  /* USER CODE END TIM3_Init 1 */
  htim3.Instance = TIM3;
  htim3.Init.Prescaler = 0;
  htim3.Init.CounterMode = TIM_COUNTERMODE_UP;
  htim3.Init.Period = 65535;
  htim3.Init.ClockDivision = TIM_CLOCKDIVISION_DIV1;
  htim3.Init.AutoReloadPreload = TIM_AUTORELOAD_PRELOAD_DISABLE;
  sConfig.EncoderMode = TIM_ENCODERMODE_TI12;
  sConfig.IC1Polarity = TIM_ICPOLARITY_RISING;
  sConfig.IC1Selection = TIM_ICSELECTION_DIRECTTI;
  sConfig.IC1Prescaler = TIM_ICPSC_DIV1;
  sConfig.IC1Filter = 2;
  sConfig.IC2Polarity = TIM_ICPOLARITY_RISING;
  sConfig.IC2Selection = TIM_ICSELECTION_DIRECTTI;
  sConfig.IC2Prescaler = TIM_ICPSC_DIV1;
  sConfig.IC2Filter = 2;
  if (HAL_TIM_Encoder_Init(&htim3, &sConfig) != HAL_OK)
  {
    Error_Handler();
  }
  sMasterConfig.MasterOutputTrigger = TIM_TRGO_RESET;
  sMasterConfig.MasterSlaveMode = TIM_MASTERSLAVEMODE_DISABLE;
  if (HAL_TIMEx_MasterConfigSynchronization(&htim3, &sMasterConfig) != HAL_OK)
  {
    Error_Handler();
  }
  /* USER CODE BEGIN TIM3_Init 2 */

  /* USER CODE END TIM3_Init 2 */
}

/**
 * @brief TIM4 Initialization Function
 * @param None
 * @retval None
 */
/**
 * @brief GPIO Initialization Function
 * @param None
 * @retval None
 */
static void MX_GPIO_Init(void)
{
  GPIO_InitTypeDef GPIO_InitStruct = {0};
  /* USER CODE BEGIN MX_GPIO_Init_1 */
  /* USER CODE END MX_GPIO_Init_1 */

  /* GPIO Ports Clock Enable */
  __HAL_RCC_GPIOC_CLK_ENABLE();
  __HAL_RCC_GPIOD_CLK_ENABLE();
  __HAL_RCC_GPIOA_CLK_ENABLE();
  __HAL_RCC_GPIOB_CLK_ENABLE();

  /*Configure GPIO pin Output Level */
  HAL_GPIO_WritePin(GPIOC, GPIO_PIN_13, GPIO_PIN_RESET);

  /*Configure GPIO pin Output Level */
  HAL_GPIO_WritePin(GPIOB, GP_UD_Pin | TP_UD_Pin | LP_UD_Pin | LP_INC_Pin | TP_INC_Pin | GP_INC_Pin | CS_ALL_Pin, GPIO_PIN_RESET);

  /*Configure GPIO pin : PC13 */
  GPIO_InitStruct.Pin = GPIO_PIN_13;
  GPIO_InitStruct.Mode = GPIO_MODE_OUTPUT_PP;
  GPIO_InitStruct.Pull = GPIO_NOPULL;
  GPIO_InitStruct.Speed = GPIO_SPEED_FREQ_LOW;
  HAL_GPIO_Init(GPIOC, &GPIO_InitStruct);

  /*Configure GPIO pins : Button1_EXTI_Pin Button2_EXTI_Pin Button3_EXTI_Pin */
  GPIO_InitStruct.Pin = Button1_EXTI_Pin | Button2_EXTI_Pin | Button3_EXTI_Pin;
  GPIO_InitStruct.Mode = GPIO_MODE_IT_FALLING;
  GPIO_InitStruct.Pull = GPIO_NOPULL;
  HAL_GPIO_Init(GPIOA, &GPIO_InitStruct);

  /*Configure GPIO pin : SW_3PDT_EXTI_Pin */
  GPIO_InitStruct.Pin = SW_3PDT_EXTI_Pin;
  GPIO_InitStruct.Mode = GPIO_MODE_IT_RISING_FALLING;
  GPIO_InitStruct.Pull = GPIO_PULLDOWN;
  HAL_GPIO_Init(SW_3PDT_EXTI_GPIO_Port, &GPIO_InitStruct);

  /*Configure GPIO pins : GP_UD_Pin TP_UD_Pin LP_UD_Pin CS_ALL_Pin */
  GPIO_InitStruct.Pin = GP_UD_Pin | TP_UD_Pin | LP_UD_Pin | CS_ALL_Pin;
  GPIO_InitStruct.Mode = GPIO_MODE_OUTPUT_PP;
  GPIO_InitStruct.Pull = GPIO_PULLUP;
  GPIO_InitStruct.Speed = GPIO_SPEED_FREQ_LOW;
  HAL_GPIO_Init(GPIOB, &GPIO_InitStruct);

  /*Configure GPIO pins : LP_INC_Pin TP_INC_Pin GP_INC_Pin */
  GPIO_InitStruct.Pin = LP_INC_Pin | TP_INC_Pin | GP_INC_Pin;
  GPIO_InitStruct.Mode = GPIO_MODE_OUTPUT_PP;
  GPIO_InitStruct.Pull = GPIO_PULLUP;
  GPIO_InitStruct.Speed = GPIO_SPEED_FREQ_HIGH;
  HAL_GPIO_Init(GPIOB, &GPIO_InitStruct);

  /*Configure GPIO pins : GAIN_EXTI_Pin TONE_EXTI_Pin LEVEL_EXTI_Pin */
  GPIO_InitStruct.Pin = GAIN_EXTI_Pin | TONE_EXTI_Pin | LEVEL_EXTI_Pin;
  GPIO_InitStruct.Mode = GPIO_MODE_IT_FALLING;
  GPIO_InitStruct.Pull = GPIO_PULLUP;
  HAL_GPIO_Init(GPIOA, &GPIO_InitStruct);

  /* EXTI interrupt init*/
  HAL_NVIC_SetPriority(EXTI3_IRQn, 0, 0);
  HAL_NVIC_EnableIRQ(EXTI3_IRQn);

  HAL_NVIC_SetPriority(EXTI4_IRQn, 0, 0);
  HAL_NVIC_EnableIRQ(EXTI4_IRQn);

  HAL_NVIC_SetPriority(EXTI9_5_IRQn, 0, 0);
  HAL_NVIC_EnableIRQ(EXTI9_5_IRQn);

  HAL_NVIC_SetPriority(EXTI15_10_IRQn, 0, 0);
  HAL_NVIC_EnableIRQ(EXTI15_10_IRQn);

  /* USER CODE BEGIN MX_GPIO_Init_2 */
  /* USER CODE END MX_GPIO_Init_2 */
}

/* USER CODE BEGIN 4 */
void HAL_GPIO_EXTI_Callback(uint16_t GPIO_Pin)
{
  uint32_t current_time = HAL_GetTick();
  if ((current_time - last_interrupt_time) < DEBOUNCE_DELAY)
  {
    return; // Ignore the interrupt if it's within the debounce delay
  }
  last_interrupt_time = current_time;

  if (GPIO_Pin == GAIN_EXTI_Pin)
  {
    Preset_Bank_selected = 0;
    gain_press_count++;
    currentState = RD_PRST_1;
  }
  else if (GPIO_Pin == TONE_EXTI_Pin)
  {
    Preset_Bank_selected = 0;
    tone_press_count++;
    currentState = RD_PRST_2;
  }
  else if (GPIO_Pin == LEVEL_EXTI_Pin)
  {
    Preset_Bank_selected = 0;
    level_press_count++;
    currentState = RD_PRST_3;
  }
  else if (GPIO_Pin == Button2_EXTI_Pin)
  {
    Preset_Bank_selected = 0;
    button1_press_count++;
    lastStateChangeTime = HAL_GetTick(); // Record the time of the state change
    Preset_Bank_selected = 0;
    switch (button1_press_count)
    {
    case 1:
      currentState = prstinit1;
      lastState = 1;
      break;
    case 2:
      currentState = prstinit2;
      lastState = 2;
      break;
    case 3:
      currentState = prstinit3;
      lastState = 3;
      button1_press_count = 0;
      break;
      // Add more cases as needed
    }
  }
  else if (GPIO_Pin == Button3_EXTI_Pin)
  {
    button2_press_count++;
    if (Preset_Bank_selected == 0)
    {
      switch (currentState)
      {
      case prstinit1:
        currentState = prst_s1;
        break;
      case prstinit2:
        currentState = prst_s2;
        break;
      case prstinit3:
        currentState = prst_s3;
        break;
      }
    }
    else
    {
      Preset_Bank_selected = 0;
      currentState = MAIN;
    }
  }
  else if (GPIO_Pin == Button1_EXTI_Pin)
  {
    button3_press_count++;
    preset_bank++;
    Preset_Bank_select();
    if (preset_bank > 8)
    {
      preset_bank = 1;
      Preset_Bank_select();
    }
    Preset_Bank_selected = 1;
  }
  else if (GPIO_Pin == SW_3PDT_EXTI_Pin)
  {
    Preset_Bank_selected = 0;
    SW_3PDT_ON++;
    if (HAL_GPIO_ReadPin(SW_3PDT_EXTI_GPIO_Port, SW_3PDT_EXTI_Pin) == GPIO_PIN_RESET)
    {
      system_locked = 0;
      currentState = MAIN;
    }
    else
    {
      system_locked = 1;
      currentState = bypassed;
    }
  }
}
/* USER CODE END 4 */

/**
 * @brief  This function is executed in case of error occurrence.
 * @retval None
 */
void Error_Handler(void)
{
  /* USER CODE BEGIN Error_Handler_Debug */
  /* User can add his own implementation to report the HAL error return state */
  __disable_irq();
  while (1)
  {
  }
  /* USER CODE END Error_Handler_Debug */
}

#ifdef USE_FULL_ASSERT
/**
 * @brief  Reports the name of the source file and the source line number
 *         where the assert_param error has occurred.
 * @param  file: pointer to the source file name
 * @param  line: assert_param error line source number
 * @retval None
 */
void assert_failed(uint8_t *file, uint32_t line)
{
  /* USER CODE BEGIN 6 */
  /* User can add his own implementation to report the file name and line number,
     ex: printf("Wrong parameters value: file %s on line %d\r\n", file, line) */
  /* USER CODE END 6 */
}
#endif /* USE_FULL_ASSERT */
